/dts-v1/;

/ {
    #address-cells = <2>;
    #size-cells = <1>;

    soc {
        compatible = "simple-bus";
        #address-cells = <1>;
        #size-cells = <1>;
        ranges;
        dma-ranges = <0xc0000000 0x0 0x00000000 0x40000000>;

        ethernet@7d580000 {
            compatible = "brcm,bcm2711-genet-v5";
            reg = <0x7d580000 0x1000>;
        };
    };
};
