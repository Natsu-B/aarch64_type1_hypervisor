/dts-v1/;

/ {
    #address-cells = <2>;
    #size-cells = <2>;

    pcie@1000120000 {
        compatible = "brcm,bcm2712-pcie";
        reg = <0x10 0x120000 0x00 0x9310>;
        #address-cells = <3>;
        #size-cells = <2>;

        ranges = <0x0 0x02000000 0x0  0x0 0x40000000  0x0 0x00100000>;
    };
};
